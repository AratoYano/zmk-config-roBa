## config/west.yml
```yaml
manifest:
  remotes:
    - name: zmkfirmware
      url-base: https://github.com/zmkfirmware
    - name: kumamuk-git
      url-base: https://github.com/kumamuk-git
  projects:
    - name: zmk
      remote: zmkfirmware
      revision: 202978550eb68453c299e5746b100858e77a4192
      import: app/west.yml
    - name: zmk-pmw3610-driver
      remote: kumamuk-git
      revision: 202978550eb68453c299e5746b100858e77a4192
  self:
    path: config
```
